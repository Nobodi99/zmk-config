## config/boards/shields/dactyl_minidox_3x5/Kconfig.defconfig
```kconfig
if SHIELD_DACTYL_MINIDOX_3X5_LEFT

config ZMK_KEYBOARD_NAME
        default "dactyl"

config ZMK_SPLIT_ROLE_CENTRAL
        default y

endif

if SHIELD_DACTYL_MINIDOX_3X5_LEFT || SHIELD_DACTYL_MINIDOX_3X5_RIGHT

config ZMK_SPLIT
        default y

endif
```

## config/boards/shields/dactyl_minidox_3x5/Kconfig.shield
```kconfig
config SHIELD_DACTYL_MINIDOX_3X5_LEFT
        def_bool $(shields_list_contains, dactyl_minidox_3x5_left)

config SHIELD_DACTYL_MINIDOX_3X5_RIGHT
        def_bool $(shields_list_contains, dactyl_minidox_3x5_right)
```
